## config/boards/shields/enki42/Kconfig.defconfig
```kconfig
# Copyright (c) 2020 The ZMK Contributors
# SPDX-License-Identifier: MIT

config ZMK_BLE
	default y

config ZMK_USB
	default y

if SHIELD_enki42_DONGLE

config ZMK_KEYBOARD_NAME
	default "enki42 Dongle"

endif

if SHIELD_ENKI42_LEFT || SHIELD_ENKI42_RIGHT

config ZMK_SPLIT
	default y

endif



if SHIELD_ENKI42_DONGLE 

config ZMK_SPLIT
	default y

config ZMK_SPLIT_BLE_ROLE_CENTRAL
	default y

endif
```

## config/boards/shields/enki42/Kconfig.shield
```kconfig
# Copyright (c) 2020 The ZMK Contributors
# SPDX-License-Identifier: MIT

config SHIELD_enki42_LEFT
	def_bool $(shields_list_contains,enki42_left)

config SHIELD_enki42_RIGHT
	def_bool $(shields_list_contains,enki42_right)

config SHIELD_enki42_DONGLE
	def_bool $(shields_list_contains,enki42_dongle)
```
